VERSION ""

NS_ :

BS_:

BU_:

BO_ 256 Msg100: 1 Vector__XXX
 SG_ bsSwitch : 0|8@1+ (1,0) [0|1] "" Vector__XXX

BA_DEF_  "BusType" STRING ;
BA_DEF_DEF_  "BusType" "CAN";
